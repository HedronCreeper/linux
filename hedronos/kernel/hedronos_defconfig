## hedronos/kernel/hedronos_defconfig
```kconfig
# HedronOS kernel configuration — generated by hedronos/tools/gen-defconfig.py.
#
# SPDX-License-Identifier: MIT
#
# Do not hand-edit: change the spec (hedronos/kernel/defconfig-spec.py) and regenerate.
# Every symbol here was found in this tree's Kconfig files; the generator drops names
# it cannot find, and --require turns those drops into a build error.


# --------------------------------------------------------------------------
# build, IPC and the syscall surface we depend on
# --------------------------------------------------------------------------
CONFIG_64BIT=y
CONFIG_LOCALVERSION="-hedron"
# LOCALVERSION_AUTO: autoversioning makes rebuilds unidentifiable
# CONFIG_LOCALVERSION_AUTO is not set
CONFIG_SYSVIPC=y
CONFIG_POSIX_MQUEUE=y
CONFIG_CROSS_MEMORY_ATTACH=y
CONFIG_WATCH_QUEUE=y
CONFIG_EPOLL=y
CONFIG_SIGNALFD=y
CONFIG_TIMERFD=y
CONFIG_EVENTFD=y
CONFIG_AIO=y
CONFIG_IO_URING=y
CONFIG_MEMBARRIER=y
CONFIG_CHECKPOINT_RESTORE=y
CONFIG_KCMP=y
CONFIG_NUMA=y

# --------------------------------------------------------------------------
# latency: tickless, 300 Hz, no RCU callbacks on the game CPUs
# --------------------------------------------------------------------------
CONFIG_NO_HZ_FULL=y
CONFIG_NO_HZ_IDLE=y
CONFIG_HZ_300=y
CONFIG_HZ=300
CONFIG_RCU_EXPERT=y
CONFIG_RCU_NOCB_CPU=y
CONFIG_VIRT_CPU_ACCOUNTING_GEN=y
CONFIG_CONTEXT_TRACKING=y
CONFIG_IRQ_TIME_ACCOUNTING=y
CONFIG_PSI=y
# PSI_DEFAULT_DISABLED: we turn it on per-session with hedron-tune
# CONFIG_PSI_DEFAULT_DISABLED is not set

# --------------------------------------------------------------------------
# scheduler: sched_ext, core scheduling, group identity
# --------------------------------------------------------------------------
CONFIG_SCHED_CLASS_EXT=y
CONFIG_SCHED_CORE=y
CONFIG_SCHED_AUTOGROUP=y
CONFIG_SCHED_MC=y
CONFIG_SCHED_SMT=y
CONFIG_SCHED_INFO=y
CONFIG_SCHEDSTATS=y
CONFIG_PREEMPT=y
CONFIG_PREEMPT_LAZY=y
CONFIG_PREEMPT_DYNAMIC=y
CONFIG_PREEMPT_NOTIFIERS=y
CONFIG_PREEMPTIRQ_TRACEPOINTS=y
CONFIG_IRQ_FORCED_THREADING=y
CONFIG_EXPERT=y
CONFIG_RT_GROUP_SCHED=y
CONFIG_CGROUP_SCHED=y
CONFIG_FAIR_GROUP_SCHED=y
CONFIG_TASKSTATS=y
CONFIG_TASK_DELAY_ACCT=y
CONFIG_TASK_XACCT=y
CONFIG_TASK_IO_ACCOUNTING=y
CONFIG_CPU_ISOLATION=y
CONFIG_RSEQ=y
CONFIG_LRU_GEN=y
CONFIG_LRU_GEN_ENABLED=y
CONFIG_NUMA_BALANCING=y

# --------------------------------------------------------------------------
# cgroups: the container of a game is a cgroup, so tune them
# --------------------------------------------------------------------------
CONFIG_CGROUP_PIDS=y
CONFIG_CGROUP_RDMA=y
CONFIG_CGROUP_FREEZER=y
CONFIG_CGROUP_HUGETLB=y
CONFIG_CGROUP_DEVICE=y
CONFIG_CGROUP_CPUACCT=y
CONFIG_CGROUP_MISC=y
CONFIG_CGROUP_BPF=y
CONFIG_CGROUP_WRITEBACK=y
CONFIG_MEMCG=y
CONFIG_BLK_CGROUP=y
CONFIG_BLK_DEV_THROTTLING=y

# --------------------------------------------------------------------------
# BPF: the plumbing half of HedronOS (sched_ext, FlowState, gamemode)
# --------------------------------------------------------------------------
CONFIG_BPF=y
CONFIG_BPF_SYSCALL=y
CONFIG_BPF_JIT=y
CONFIG_BPF_JIT_ALWAYS_ON=y
CONFIG_BPF_JIT_DEFAULT_ON=y
CONFIG_BPF_EVENTS=y
CONFIG_BPF_LSM=y
CONFIG_BPF_STREAM_PARSER=y
CONFIG_BPF_UNPRIV_DEFAULT_OFF=y
CONFIG_DEBUG_INFO_BTF=y
CONFIG_MODULE_ALLOW_BTF_MISMATCH=y
CONFIG_NET_CLS_BPF=m
CONFIG_NET_ACT_BPF=m

# --------------------------------------------------------------------------
# tracing: how hedron-latency and hedron-doctor see the kernel
# --------------------------------------------------------------------------
CONFIG_FTRACE=y
CONFIG_FUNCTION_TRACER=y
CONFIG_FUNCTION_GRAPH_TRACER=y
CONFIG_HWLAT_TRACER=y
CONFIG_OSNOISE_TRACER=y
CONFIG_TIMERLAT_TRACER=y
CONFIG_SCHED_TRACER=y
CONFIG_FTRACE_SYSCALLS=y
CONFIG_BLK_DEV_IO_TRACE=y
CONFIG_KPROBES=y
CONFIG_KPROBE_EVENTS=y
CONFIG_UPROBES=y
CONFIG_UPROBE_EVENTS=y
CONFIG_HIST_TRIGGERS=y
CONFIG_TRACER_SNAPSHOT=y
CONFIG_HARDLOCKUP_DETECTOR=m
CONFIG_RING_BUFFER_BENCHMARK=m
CONFIG_FUNCTION_ERROR_INJECTION=y
CONFIG_FAULT_INJECTION=y
CONFIG_FAULT_INJECTION_DEBUG_FS=y
CONFIG_DEBUG_FS=y
CONFIG_KALLSYMS=y
CONFIG_KALLSYMS_ALL=y
CONFIG_IKCONFIG=y
CONFIG_IKCONFIG_PROC=y
CONFIG_IKHEADERS=y
CONFIG_PROC_KCORE=y
# LIVEPATCH: out of scope for an image that updates as a whole
# CONFIG_LIVEPATCH is not set
CONFIG_ENVELOPE_DETECTOR=m

# --------------------------------------------------------------------------
# power: governors, RAPL, thermal, suspend and hibernation
# --------------------------------------------------------------------------
CONFIG_CPU_FREQ=y
CONFIG_CPU_FREQ_DEFAULT_GOV_SCHEDUTIL=y
CONFIG_CPU_FREQ_GOV_PERFORMANCE=y
CONFIG_CPU_FREQ_GOV_POWERSAVE=y
CONFIG_CPU_FREQ_GOV_USERSPACE=y
CONFIG_CPU_FREQ_GOV_ONDEMAND=y
CONFIG_CPU_FREQ_GOV_CONSERVATIVE=y
CONFIG_CPU_FREQ_GOV_SCHEDUTIL=y
CONFIG_X86_PCC_CPUFREQ=y
CONFIG_X86_ACPI_CPUFREQ=y
CONFIG_X86_AMD_PSTATE=y
CONFIG_CPU_IDLE=y
CONFIG_CPU_IDLE_GOV_MENU=y
CONFIG_CPU_IDLE_GOV_TEO=y
CONFIG_CPU_IDLE_GOV_HALTPOLL=y
CONFIG_HALTPOLL_CPUIDLE=y
CONFIG_INTEL_IDLE=y
CONFIG_INTEL_HFI_THERMAL=y
CONFIG_POWERCAP=y
CONFIG_INTEL_RAPL=y
CONFIG_POWER_RESET=y
CONFIG_POWER_SUPPLY_HWMON=y
CONFIG_THERMAL=y
CONFIG_THERMAL_STATISTICS=y
CONFIG_THERMAL_NETLINK=y
CONFIG_THERMAL_GOV_STEP_WISE=y
CONFIG_CPU_THERMAL=y
CONFIG_X86_PKG_TEMP_THERMAL=y
CONFIG_ACPI_THERMAL=y
CONFIG_ACPI_PROCESSOR=y
CONFIG_ACPI_PROCESSOR_CSTATE=y
CONFIG_ACPI_BUTTON=y
CONFIG_ACPI_FAN=y
CONFIG_ACPI_BATTERY=y
CONFIG_ACPI_AC=y
CONFIG_ACPI_NUMA=y
CONFIG_ACPI_PLATFORM_PROFILE=y
CONFIG_ACPI_BGRT=y
CONFIG_ACPI_WMI=y
CONFIG_PM=y
CONFIG_PM_ADVANCED_DEBUG=y
CONFIG_PM_WAKELOCKS=y
CONFIG_SUSPEND=y
CONFIG_SUSPEND_FREEZER=y
CONFIG_HIBERNATE_CALLBACKS=y
CONFIG_HIBERNATION=y
CONFIG_HIBERNATION_SNAPSHOT_DEV=y
CONFIG_PM_AUTOSLEEP=y
CONFIG_X86_INTEL_PSTATE=y

# --------------------------------------------------------------------------
# memory: zswap, LRU gen, huge pages, zero-on-alloc
# --------------------------------------------------------------------------
CONFIG_TRANSPARENT_HUGEPAGE=y
CONFIG_TRANSPARENT_HUGEPAGE_ALWAYS=y
CONFIG_HUGETLB_PAGE=y
CONFIG_HUGETLBFS=y
CONFIG_ZSWAP=y
CONFIG_ZSWAP_DEFAULT_ON=y
CONFIG_ZSMALLOC=y
CONFIG_ZRAM=m
CONFIG_ZRAM_WRITEBACK=y
CONFIG_KSM=y
CONFIG_MEMORY_HOTPLUG=y
CONFIG_COMPACTION=y
CONFIG_MIGRATION=y
CONFIG_PAGE_REPORTING=y
CONFIG_IDLE_PAGE_TRACKING=y
CONFIG_PAGE_OWNER=y
CONFIG_MEM_SOFT_DIRTY=y
CONFIG_USERFAULTFD=y
CONFIG_INIT_ON_ALLOC_DEFAULT_ON=y
CONFIG_INIT_STACK_ALL_PATTERN=y
CONFIG_SLAB_FREELIST_HARDENED=y
CONFIG_SLAB_FREELIST_RANDOM=y
CONFIG_SHUFFLE_PAGE_ALLOCATOR=y

# --------------------------------------------------------------------------
# security: lockdown, module signing, verity, TPM, keyring
# --------------------------------------------------------------------------
CONFIG_SECURITY_LOCKDOWN_LSM=y
CONFIG_SECURITY_LOCKDOWN_LSM_EARLY=y
CONFIG_STACKPROTECTOR_STRONG=y
CONFIG_STRICT_KERNEL_RWX=y
CONFIG_STRICT_MODULE_RWX=y
CONFIG_HARDENED_USERCOPY=y
CONFIG_FORTIFY_SOURCE=y
CONFIG_RANDOMIZE_BASE=y
CONFIG_RANDOMIZE_MEMORY=y
CONFIG_MITIGATION_RETPOLINE=y
CONFIG_CPU_MITIGATIONS=y
CONFIG_ZERO_CALL_USED_REGS=y
CONFIG_MODULE_SIG=y
CONFIG_MODULE_SIG_ALL=y
CONFIG_MODULE_SIG_SHA256=y
CONFIG_MODULE_SIG_HASH="sha256"
CONFIG_MODULE_SIG_KEY="certs/signing_key.pem"
CONFIG_MODULE_SIG_KEY_TYPE_ECDSA=y
# MODULE_SIG_FORCE: unsigned out-of-tree DKMS builds must still load
# CONFIG_MODULE_SIG_FORCE is not set
CONFIG_SYSTEM_TRUSTED_KEYS=""
CONFIG_SYSTEM_REVOCATION_KEYS=""
CONFIG_INTEGRITY=y
CONFIG_IMA=y
CONFIG_AUDIT=y
CONFIG_LSM="landlock,lockdown,yama,integrity,selinux,bpf"
CONFIG_KEYS=y
CONFIG_PERSISTENT_KEYRINGS=y
CONFIG_TRUSTED_KEYS=m
CONFIG_ENCRYPTED_KEYS=m
CONFIG_DM_CRYPT=y
CONFIG_DM_VERITY=y
CONFIG_DM_VERITY_FEC=y
CONFIG_DM_INTEGRITY=y
CONFIG_FS_VERITY=y
CONFIG_FS_VERITY_BUILTIN_SIGNATURES=y
CONFIG_FS_ENCRYPTION=y
CONFIG_TCG_TPM=y
CONFIG_TCG_TIS=y
CONFIG_TCG_TIS_I2C=y
CONFIG_TCG_TIS_SPI=y
CONFIG_EFI_ESRT=y
CONFIG_EFI_CAPSULE_LOADER=y
CONFIG_RESET_ATTACK_MITIGATION=y
CONFIG_APPLE_PROPERTIES=y
CONFIG_ACPI_APEI=y
CONFIG_ACPI_APEI_PCIEAER=y
CONFIG_KEXEC=y
CONFIG_KEXEC_FILE=y
CONFIG_EXPOLINE=y

# --------------------------------------------------------------------------
# graphics: amdgpu, i915, xe, nova, nouveau, radeon, kms
# --------------------------------------------------------------------------
CONFIG_DRM=y
CONFIG_DRM_KMS_HELPER=y
CONFIG_DRM_FBDEV_EMULATION=y
CONFIG_DRM_FBDEV_OVERALLOC=100
CONFIG_DRM_CLIENT=y
CONFIG_DRM_CLIENT_LIB=y
CONFIG_DRM_CLIENT_SELECTION=y
CONFIG_DRM_CLIENT_SETUP=y
CONFIG_DRM_TTM=y
CONFIG_DRM_TTM_HELPER=y
CONFIG_DRM_GPUVM=y
CONFIG_DRM_EXEC=y
CONFIG_DRM_GEM_SHMEM_HELPER=y
CONFIG_DRM_BUDDY=y
CONFIG_DRM_SUBALLOC_HELPER=y
CONFIG_DRM_PANEL=y
CONFIG_DRM_BRIDGE=y
CONFIG_DRM_AUX_BRIDGE=y
CONFIG_DRM_AUX_HPD_BRIDGE=y
CONFIG_DRM_DISPLAY_DP_HELPER=y
CONFIG_DRM_DISPLAY_HDMI_HELPER=y
CONFIG_DRM_DISPLAY_HDCP_HELPER=y
# DRM_KUNIT_TEST: tests run in CI, not in your kernel
# CONFIG_DRM_KUNIT_TEST is not set
CONFIG_DRM_USE_DYNAMIC_DEBUG=y
CONFIG_DRM_NOUVEAU=m
CONFIG_DRM_NOUVEAU_BACKLIGHT=y
CONFIG_DRM_NOVA=y
CONFIG_DRM_AMDGPU=y
CONFIG_DRM_AMDGPU_USERPTR=y
CONFIG_DRM_AMD_DC=y
CONFIG_DRM_AMD_DC_SI=y
CONFIG_HSA_AMD=y
CONFIG_DRM_RADEON=y
CONFIG_DRM_RADEON_USERPTR=y
CONFIG_DRM_I915=y
CONFIG_DRM_I915_CAPTURE_ERROR=y
CONFIG_DRM_I915_COMPRESS_ERROR=y
CONFIG_DRM_I915_USERPTR=y
CONFIG_DRM_I915_LOW_LEVEL_TRACEPOINTS=y
# CONFIG_DRM_I915_SELFTEST is not set
CONFIG_DRM_XE=y
CONFIG_DRM_XE_DISPLAY=y
CONFIG_DRM_V3D=m
CONFIG_DRM_PANTHOR=m
CONFIG_DRM_QXL=m
CONFIG_DRM_BOCHS=m
CONFIG_DRM_VIRTIO_GPU=m
CONFIG_DRM_VKMS=m
CONFIG_DRM_AST=m
CONFIG_DRM_MGAG200=m
CONFIG_DRM_SIMPLEDRM=y
CONFIG_DRM_LOAD_EDID_FIRMWARE=y
CONFIG_DRM_HYPERV=m
CONFIG_DRM_ACCEL=y
CONFIG_DRM_ACCEL_IVPU=m
CONFIG_DRM_ACCEL_QAIC=m
CONFIG_LOGO=y
CONFIG_LOGO_LINUX_CLUT224=y
CONFIG_BACKLIGHT_CLASS_DEVICE=y
CONFIG_BACKLIGHT_GPIO=y
CONFIG_LCD_CLASS_DEVICE=m
CONFIG_VGA_CONSOLE=y
CONFIG_VT_HW_CONSOLE_BINDING=y
CONFIG_FRAMEBUFFER_CONSOLE=y
CONFIG_FRAMEBUFFER_CONSOLE_ROTATION=y
CONFIG_DRM_AMD_DC_FP=y
CONFIG_DRM_XE_GPUSVM=y
# CONFIG_DRM_XE_DEBUG_SRIOV is not set

# --------------------------------------------------------------------------
# audio: HDA (including the codec list), SOF, USB audio, OSS compat
# --------------------------------------------------------------------------
CONFIG_SOUND=y
CONFIG_SND=y
CONFIG_SND_TIMER=y
CONFIG_SND_PCM=y
CONFIG_SND_HWDEP=y
CONFIG_SND_RAWMIDI=y
CONFIG_SND_JACK=y
CONFIG_SND_SEQ_DEVICE=y
CONFIG_SND_SEQUENCER=y
CONFIG_SND_SEQ_DUMMY=m
CONFIG_SND_OSSEMUL=y
CONFIG_SND_PCM_OSS=y
CONFIG_SND_HRTIMER=y
CONFIG_SND_DYNAMIC_MINORS=y
CONFIG_SND_MAX_CARDS=32
# CONFIG_SND_SUPPORT_OLD_API is not set
CONFIG_SND_SOC_TOPOLOGY=y
CONFIG_SND_CTL_FAST_LOOKUP=y
CONFIG_SND_HDA=y
CONFIG_SND_HDA_INTEL=y
CONFIG_SND_HDA_HWDEP=y
CONFIG_SND_HDA_RECONFIG=y
# SND_HDA_INPUT_BEEP: the beep is a bug to every gamer alive
# CONFIG_SND_HDA_INPUT_BEEP is not set
CONFIG_SND_HDA_PATCH_LOADER=y
CONFIG_SND_HDA_COMPONENT=y
CONFIG_SND_HDA_CODEC_REALTEK=y
CONFIG_SND_HDA_CODEC_ANALOG=y
CONFIG_SND_HDA_CODEC_SIGMATEL=y
CONFIG_SND_HDA_CODEC_VIA=y
CONFIG_SND_HDA_CODEC_HDMI=y
CONFIG_SND_HDA_CODEC_CIRRUS=y
CONFIG_SND_HDA_CODEC_CONEXANT=y
CONFIG_SND_HDA_CODEC_CA0110=y
CONFIG_SND_HDA_CODEC_CA0132=y
CONFIG_SND_HDA_CODEC_CMEDIA=y
CONFIG_SND_HDA_CODEC_SI3054=y
CONFIG_SND_USB_AUDIO=y
CONFIG_SND_USB_UA101=y
CONFIG_SND_USB_CAIAQ=m
CONFIG_SND_SOC=y
CONFIG_SND_SOC_ACPI=y
CONFIG_SND_SOC_SOF_TOPLEVEL=y
CONFIG_SND_SOC_SOF_PCI=y
CONFIG_SND_SOC_SOF_ACPI=y
CONFIG_SND_SOC_SOF_ACPI_DEV=y
CONFIG_SND_SOC_SOF_DEVELOPER_SUPPORT=y
CONFIG_SND_SOC_SOF_HDA_LINK=y
CONFIG_SND_SOC_SOF_HDA_AUDIO_CODEC=y
CONFIG_SND_SOC_SOF_INTEL_HIFI_EP_IPC=y
CONFIG_SND_SOC_SOF_INTEL_ATOM_HIFI_EP=y
CONFIG_SND_SOC_SOF_INTEL_CNL=y
CONFIG_SND_SOC_SOF_INTEL_LNL=y
CONFIG_SND_SOC_SOF_INTEL_TGL=y
CONFIG_SND_SOC_INTEL_SST_TOPLEVEL=y
CONFIG_SND_HDA_I915=y

# --------------------------------------------------------------------------
# input and HID: controllers, wheels, pads, touch, the handheld keys
# --------------------------------------------------------------------------
CONFIG_INPUT=y
CONFIG_INPUT_KEYBOARD=y
CONFIG_INPUT_MOUSE=y
CONFIG_SERIO_I8042=y
CONFIG_SERIO_LIBPS2=y
CONFIG_INPUT_JOYSTICK=y
CONFIG_INPUT_TABLET=y
CONFIG_INPUT_TOUCHSCREEN=y
CONFIG_INPUT_MISC=y
CONFIG_INPUT_UINPUT=y
CONFIG_INPUT_EVDEV=y
CONFIG_INPUT_MOUSEDEV=y
CONFIG_RMI4_CORE=m
CONFIG_RMI4_I2C=m
CONFIG_RMI4_SMB=m
CONFIG_TOUCHSCREEN_ATMEL_MXT=m
CONFIG_TOUCHSCREEN_ELAN=m
CONFIG_TOUCHSCREEN_WACOM_I2C=m
CONFIG_HID=y
CONFIG_HIDRAW=y
CONFIG_UHID=y
CONFIG_HID_GENERIC=y
CONFIG_HID_MULTITOUCH=y
CONFIG_HID_MICROSOFT=y
CONFIG_HID_LOGITECH=y
CONFIG_LOGITECH_FF=y
CONFIG_LOGIRUMBLEPAD2_FF=y
CONFIG_LOGIG940_FF=y
CONFIG_LOGIWHEELS_FF=y
CONFIG_HID_APPLE=y
CONFIG_HID_WACOM=y
CONFIG_HID_PICOLCD=m
CONFIG_HID_PLAYSTATION=m
CONFIG_PLAYSTATION_FF=y
CONFIG_JOYSTICK_XPAD=m
CONFIG_JOYSTICK_XPAD_FF=m
CONFIG_JOYSTICK_XPAD_LEDS=m
CONFIG_HID_NINTENDO=y
CONFIG_NINTENDO_FF=y
CONFIG_HID_STEAM=m
CONFIG_HID_ASUS=m
CONFIG_HID_LENOVO=m
CONFIG_I2C_HID_CORE=m
CONFIG_I2C_HID_ACPI=m
CONFIG_I2C_HID_OF=m
CONFIG_HID_SENSOR_HUB=y
CONFIG_HID_SENSOR_ACCEL_3D=m
CONFIG_HID_SENSOR_GYRO_3D=m
CONFIG_HID_SENSOR_IIO_COMMON=m
CONFIG_HID_SENSOR_IIO_TRIGGER=m
CONFIG_INTEL_HID_EVENT=m
CONFIG_INTEL_VBTN=m

# --------------------------------------------------------------------------
# IIO: accelerometers for tablet/Handheld auto-rotate
# --------------------------------------------------------------------------
CONFIG_IIO=y
CONFIG_IIO_BUFFER=y
CONFIG_IIO_TRIGGER=y
CONFIG_IIO_KFIFO_BUF=y
CONFIG_IIO_TRIGGERED_BUFFER=y
CONFIG_BMI088_ACCEL=m
CONFIG_BMI088_ACCEL_I2C=m
CONFIG_BMI160_I2C=m
CONFIG_BMI160_SPI=m
CONFIG_KMX61=m
CONFIG_INV_MPU6050_IIO=m
CONFIG_IIO_ST_ACCEL_I2C_3AXIS=m
CONFIG_IIO_ST_ACCEL_SPI_3AXIS=m
CONFIG_IIO_SW_TRIGGER=m

# --------------------------------------------------------------------------
# USB and Thunderbolt/USB4
# --------------------------------------------------------------------------
CONFIG_USB=y
CONFIG_USB_ANNOUNCE_NEW_DEVICES=y
CONFIG_USB_XHCI_HCD=y
CONFIG_USB_XHCI_PCI=y
CONFIG_USB_XHCI_PLATFORM=y
CONFIG_USB_EHCI_HCD=y
CONFIG_USB_OHCI_HCD=y
CONFIG_USB_UHCI_HCD=y
CONFIG_USB_STORAGE=y
CONFIG_USB_UAS=y
CONFIG_USB_ACM=m
CONFIG_USB_PRINTER=m
CONFIG_USB_WDM=m
CONFIG_USB_SERIAL=m
CONFIG_USB_SERIAL_FTDI_SIO=m
CONFIG_USB_SERIAL_CH341=m
CONFIG_USB_SERIAL_CP210X=m
CONFIG_USB_AUDIO=m
CONFIG_USB_GADGET=m
CONFIG_USB_CONFIGFS=m
CONFIG_USB_CONFIGFS_F_HID=y
CONFIG_USB_CONFIGFS_F_UAC2=y
CONFIG_USB_MON=y
CONFIG_USB_ROLE_SWITCH=y
CONFIG_USB4=y
CONFIG_USB4_NET=y
CONFIG_TYPEC=y
CONFIG_TYPEC_UCSI=y
CONFIG_UCSI_ACPI=y
CONFIG_TYPEC_DP_ALTMODE=y
CONFIG_TYPEC_MUX_PI3USB30532=m
CONFIG_USB_OHCI_LITTLE_ENDIAN=y
CONFIG_USB_LED_TRIG=y

# --------------------------------------------------------------------------
# networking: BBR, wireguard, nftables, wifi, bluetooth
# --------------------------------------------------------------------------
CONFIG_NET=y
CONFIG_NET_CORE=y
CONFIG_PACKET=y
CONFIG_UNIX=y
CONFIG_NET_PKTGEN=m
CONFIG_WIREGUARD=y
CONFIG_TUN=m
CONFIG_TAP=m
CONFIG_VETH=m
CONFIG_BRIDGE=m
CONFIG_BRIDGE_VLAN_FILTERING=y
CONFIG_DUMMY=m
CONFIG_BONDING=m
CONFIG_VSOCKETS=y
CONFIG_VHOST_VSOCK=m
CONFIG_MPTCP=y
CONFIG_INET_MPTCP_DIAG=m
CONFIG_SMC=m
CONFIG_TLS=y
# CONFIG_TLS_DEVICE is not set
CONFIG_TCP_CONG_CUBIC=y
CONFIG_TCP_CONG_BBR=y
CONFIG_DEFAULT_TCP_CONG="bbr"
CONFIG_TCP_AO=y
CONFIG_TCP_MD5SIG=y
CONFIG_INET_DIAG_DESTROY=y
CONFIG_NET_IPIP=m
CONFIG_NET_IPGRE_DEMUX=m
CONFIG_VXLAN=m
CONFIG_MACVLAN=m
CONFIG_NETFILTER=y
CONFIG_NF_TABLES=y
CONFIG_NFT_CT=y
CONFIG_NFT_NAT=y
CONFIG_NFT_MASQ=y
CONFIG_NFT_REJECT=y
CONFIG_NFT_COMPAT=m
CONFIG_NF_CONNTRACK=y
CONFIG_NF_NAT=y
CONFIG_NF_NAT_MASQUERADE=y
CONFIG_NET_SCHED=y
CONFIG_NET_SCH_FQ=y
CONFIG_NET_SCH_FQ_CODEL=y
CONFIG_NET_SCH_CAKE=m
CONFIG_NET_SCH_TAPRIO=y
CONFIG_NET_SCH_CBS=y
CONFIG_NET_SCH_MULTIQ=m
CONFIG_NET_SCH_FIFO=y
CONFIG_NET_SCH_PLUG=m
CONFIG_NET_CLS_U32=y
CONFIG_NET_EMATCH=y
CONFIG_NET_ACT_MIRRED=m
CONFIG_NET_ACT_GACT=m
CONFIG_PTP_1588_CLOCK=y
CONFIG_NET_PTP_CLASSIFY=y
CONFIG_CAN=m
CONFIG_WIRELESS=y
CONFIG_CFG80211=m
CONFIG_NL80211_TESTMODE=y
CONFIG_MAC80211=m
CONFIG_WLAN=y
CONFIG_WEXT_CORE=y
CONFIG_WEXT_PROC=y
CONFIG_WEXT_PRIV=y
CONFIG_ATH11K=m
CONFIG_ATH11K_PCI=m
CONFIG_ATH12K=m
CONFIG_IWLEGACY=m
CONFIG_IWLWIFI=m
CONFIG_IWLDVM=m
CONFIG_IWLMVM=m
CONFIG_IWLWIFI_OPMODE_MODULAR=y
CONFIG_MWIFIEX=m
CONFIG_MWIFIEX_PCIE=m
CONFIG_RTW89=m
CONFIG_RTW89_PCI=m
CONFIG_RTW89_8852AE=m
CONFIG_MT7921E=m
CONFIG_MT76x2E=m
CONFIG_BT=m
CONFIG_BT_BREDR=y
CONFIG_BT_LE=y
CONFIG_BT_LE_L2CAP_ECRED=y
CONFIG_BT_HCIBTUSB=m
CONFIG_BT_HCIBTUSB_MTK=y
CONFIG_BT_HIDP=m
CONFIG_BT_HCIVHCI=m
CONFIG_RFKILL=m
CONFIG_RFKILL_INPUT=m
CONFIG_AF_KCM=y
CONFIG_XFRM_USER=m
CONFIG_IP_VS=m
CONFIG_L2TP=m
CONFIG_PPP=m
CONFIG_PPPOE=m
CONFIG_PPTP=m
# CONFIG_X86_AMD_PSTATE_UT is not set

# --------------------------------------------------------------------------
# filesystems: btrfs (the install default), ext4, xfs, f2fs, NTFS3, network
# --------------------------------------------------------------------------
CONFIG_EXT4_FS=y
CONFIG_EXT4_FS_POSIX_ACL=y
CONFIG_EXT4_FS_SECURITY=y
CONFIG_BTRFS_FS=y
CONFIG_BTRFS_FS_POSIX_ACL=y
CONFIG_F2FS_FS=y
CONFIG_XFS_FS=y
CONFIG_XFS_QUOTA=y
CONFIG_XFS_POSIX_ACL=y
CONFIG_JBD2=y
CONFIG_QUOTA=y
CONFIG_QUOTA_NETLINK_INTERFACE=y
CONFIG_DNOTIFY=y
CONFIG_INOTIFY_USER=y
CONFIG_FANOTIFY=y
CONFIG_FANOTIFY_ACCESS_PERMISSIONS=y
CONFIG_AUTOFS_FS=y
CONFIG_FUSE_FS=y
CONFIG_CUSE=m
CONFIG_VIRTIO_FS=m
CONFIG_9P_FS=m
CONFIG_NET_9P=m
CONFIG_OVERLAY_FS=y
CONFIG_OVERLAY_FS_INDEX=y
CONFIG_OVERLAY_FS_REDIRECT_DIR=y
CONFIG_FHANDLE=y
CONFIG_TMPFS=y
CONFIG_TMPFS_XATTR=y
CONFIG_TMPFS_INODE64=y
CONFIG_CONFIGFS_FS=y
CONFIG_MEMFD_CREATE=y
CONFIG_MSDOS_FS=y
CONFIG_VFAT_FS=y
CONFIG_FAT_DEFAULT_UTF8=y
CONFIG_EXFAT_FS=m
CONFIG_NTFS3_FS=m
CONFIG_NTFS3_LZX_XPRESS=y
CONFIG_ISO9660_FS=y
CONFIG_JOLIET=y
CONFIG_ZISOFS=y
CONFIG_UDF_FS=m
CONFIG_HFSPLUS_FS=m
CONFIG_NLS_CODEPAGE_437=y
CONFIG_NLS_ISO8859_1=y
CONFIG_NLS_UTF8=y
CONFIG_CIFS=m
CONFIG_CIFS_POSIX=y
CONFIG_CIFS_UPCALL=y
CONFIG_CIFS_XATTR=y
CONFIG_CIFS_DFS_UPCALL=y
CONFIG_CIFS_SMB_DIRECT=y
CONFIG_SMBFS=m
CONFIG_NFS_FS=y
CONFIG_NFS_V4=y
CONFIG_NFS_V4_2=y
CONFIG_ROOT_NFS=y
CONFIG_DLM=m
CONFIG_BLOCK=y
CONFIG_MSDOS_PARTITION=y
CONFIG_EFI_PARTITION=y
CONFIG_BINFMT_MISC=y
CONFIG_BINFMT_SCRIPT=y

# --------------------------------------------------------------------------
# block: NVMe, AHCI, RAID, dm, DAX
# --------------------------------------------------------------------------
CONFIG_BLK_DEV_LOOP=y
CONFIG_BLK_DEV_NBD=m
CONFIG_BLK_DEV_RAM=m
CONFIG_ATA=y
CONFIG_SATA_AHCI=y
CONFIG_SATA_AHCI_PLATFORM=y
CONFIG_ATA_PIIX=y
CONFIG_PATA_MPIIX=y
CONFIG_NVME_CORE=y
CONFIG_BLK_DEV_NVME=y
CONFIG_NVME_MULTIPATH=y
CONFIG_NVME_HWMON=y
CONFIG_NVME_FABRICS=m
CONFIG_BLK_DEV_SD=y
CONFIG_CHR_DEV_SG=y
CONFIG_BLK_DEV_SR=y
CONFIG_CHR_DEV_SCH=m
CONFIG_MD=y
CONFIG_BLK_DEV_MD=y
CONFIG_MD_RAID0=y
CONFIG_MD_RAID1=y
CONFIG_MD_RAID10=y
CONFIG_MD_RAID456=y
CONFIG_BCACHE=m
CONFIG_DM_SNAPSHOT=y
CONFIG_DM_THIN_PROVISIONING=y
CONFIG_DM_UEVENT=y
CONFIG_DM_VDO=m
CONFIG_LIBNVDIMM=y
CONFIG_BLK_DEV_PMEM=y
CONFIG_DAX=y
CONFIG_DEV_DAX_KMEM=m
# UEVENT_HELPER: systemd handles uevents; the helper is a boot-time race
# CONFIG_UEVENT_HELPER is not set
CONFIG_BLK_DEV_BSGLIB=y
CONFIG_BLK_DEV_INTEGRITY=y
# CONFIG_BLOCK_LEGACY_AUTOLOAD is not set

# --------------------------------------------------------------------------
# crypto: hardware-accelerated, plus the compression libs
# --------------------------------------------------------------------------
CONFIG_CRYPTO=y
CONFIG_CRYPTO_USER=m
CONFIG_CRYPTO_USER_API=y
CONFIG_CRYPTO_USER_API_AEAD=y
CONFIG_CRYPTO_USER_API_HASH=y
CONFIG_CRYPTO_USER_API_SKCIPHER=y
CONFIG_CRYPTO_USER_API_RNG=y
CONFIG_CRYPTO_GCM=y
CONFIG_CRYPTO_CHACHA20POLY1305=y
CONFIG_CRYPTO_ARIA=y
CONFIG_CRYPTO_CAMELLIA=y
CONFIG_CRYPTO_SM4=y
CONFIG_CRYPTO_SM3=y
CONFIG_CRYPTO_SERPENT=y
CONFIG_CRYPTO_TWOFISH=y
CONFIG_CRYPTO_BLOWFISH=y
CONFIG_CRYPTO_BLAKE2B=y
CONFIG_CRYPTO_XXHASH=y
CONFIG_CRYPTO_LZ4=y
CONFIG_CRYPTO_LZ4HC=y
CONFIG_CRYPTO_ZSTD=y
CONFIG_CRYPTO_DEFLATE=y
CONFIG_CRYPTO_SIMD=y
CONFIG_CRYPTO_CRYPTD=y
CONFIG_CRYPTO_AES_NI_INTEL=y
CONFIG_CRYPTO_MANAGER=y
CONFIG_CRYPTO_AUTHENC=y
CONFIG_CRYPTO_HW=y
CONFIG_CRYPTO_DEV_VIRTIO=m
# CONFIG_CRYPTO_DEV_AMLOGIC_GXL is not set
CONFIG_CRYPTO_SELFTESTS=y
CONFIG_ZSTD_COMPRESS=y
CONFIG_ZSTD_DECOMPRESS=y
CONFIG_LZ4_COMPRESS=y
CONFIG_LZ4_DECOMPRESS=y
CONFIG_LZ4HC_COMPRESS=y

# --------------------------------------------------------------------------
# platform drivers: vendor laptops, handhelds, tablets
# --------------------------------------------------------------------------
CONFIG_AMD_PMC=y
CONFIG_AMD_PMF=y
CONFIG_AMD_HSMP=y
CONFIG_AMD_WBRF=y
CONFIG_INTEL_SOC_PMIC=y
CONFIG_INTEL_PMC_CORE=y
CONFIG_INTEL_PMT_CLASS=y
CONFIG_INTEL_PUNIT_IPC=y
CONFIG_INTEL_RST=y
CONFIG_INTEL_SMARTCONNECT=y
CONFIG_INTEL_TURBO_MAX_3=y
CONFIG_INTEL_UNCORE_FREQ_CONTROL=y
CONFIG_SURFACE_AGGREGATOR=y
CONFIG_SURFACE_AGGREGATOR_CDEV=y
CONFIG_SURFACE_HID=y
CONFIG_SURFACE_KBD=y
CONFIG_SURFACE_PLATFORMS=y
CONFIG_IDEAPAD_LAPTOP=m
CONFIG_INPUT_IDEAPAD_SLIDEBAR=y
CONFIG_YOGABOOK=m
CONFIG_MSI_EC=m
CONFIG_MSI_LAPTOP=m
CONFIG_ASUS_WMI=y
CONFIG_ASUS_NB_WMI=y
CONFIG_ASUS_WIRELESS=m
CONFIG_AYANEO_EC=m
CONFIG_WMI_BMOF=y
CONFIG_PVPANIC=m
CONFIG_DMI_SYSFS=y
CONFIG_DMIID=y
CONFIG_DELL_RBTN=m
CONFIG_DELL_SMO8800=m
CONFIG_DELL_WMI=m
CONFIG_FUJITSU_LAPTOP=m
CONFIG_SAMSUNG_Q10=m
CONFIG_TC1100_WMI=m
CONFIG_SONY_LAPTOP=m
CONFIG_INTEL_OAKTRAIL=m
CONFIG_X86_PLATFORM_DRIVERS_DELL=y
CONFIG_X86_PLATFORM_DRIVERS_HP=y

# --------------------------------------------------------------------------
# sensors and watchdogs: what hedron-vitals reads
# --------------------------------------------------------------------------
CONFIG_HWMON=y
CONFIG_SENSORS_K8TEMP=y
CONFIG_SENSORS_K10TEMP=y
CONFIG_SENSORS_CORETEMP=y
CONFIG_SENSORS_IT87=y
CONFIG_SENSORS_NCT6775=y
CONFIG_SENSORS_NCT6683=m
CONFIG_SENSORS_F71882FG=m
CONFIG_SENSORS_LM90=m
CONFIG_SENSORS_LM75=m
CONFIG_SENSORS_ASUS_EC=m
CONFIG_SENSORS_ACPI_POWER=m
CONFIG_HWMON_VID=m
CONFIG_WATCHDOG=y
# CONFIG_WATCHDOG_NOWAYOUT is not set
CONFIG_ITCO_WDT=y
CONFIG_IT87_WDT=m
CONFIG_SOFT_WATCHDOG=m
CONFIG_PCIPCWATCHDOG=m
CONFIG_INTEL_MEI=m
CONFIG_INTEL_MEI_ME=m
CONFIG_INTEL_MEI_WDT=m
CONFIG_SENSORS_MAX197=m

# --------------------------------------------------------------------------
# virtualisation: KVM/SEV/TDX, so a HedronOS box can host a Windows VM
# --------------------------------------------------------------------------
CONFIG_KVM=y
CONFIG_KVM_AMD=y
CONFIG_KVM_INTEL=y
CONFIG_KVM_ASYNC_PF=y
CONFIG_KVM_HYPERV=y
CONFIG_VHOST=m
CONFIG_VHOST_NET=m
CONFIG_VHOST_SCSI=m
CONFIG_X86_SGX_KVM=y
CONFIG_INTEL_TDX_GUEST=y
CONFIG_INTEL_TDX_HOST=y
CONFIG_KVM_INTEL_TDX=y
CONFIG_AMD_MEM_ENCRYPT=y
CONFIG_KVM_AMD_SEV=y
CONFIG_HYPERV=y
CONFIG_HYPERV_KEYBOARD=y
CONFIG_HID_HYPERV_MOUSE=m
CONFIG_VBOXGUEST=m
CONFIG_VMWARE_VMCI=m
CONFIG_VIRT_DRIVERS=y
CONFIG_X86_X2APIC=y

# --------------------------------------------------------------------------
# media/I2C/GPIO: capture cards, webcams, boards
# --------------------------------------------------------------------------
CONFIG_MEDIA_SUPPORT=m
CONFIG_MEDIA_CAMERA_SUPPORT=y
CONFIG_MEDIA_DIGITAL_TV_SUPPORT=y
CONFIG_MEDIA_CONTROLLER=y
CONFIG_MEDIA_CEC_SUPPORT=y
CONFIG_CEC_CORE=y
CONFIG_CEC_NOTIFIER=y
CONFIG_VIDEO_DEV=m
CONFIG_VIDEO_V4L2_SUBDEV_API=y
CONFIG_VIDEOBUF2_CORE=m
CONFIG_VIDEOBUF2_V4L2=m
CONFIG_VIDEOBUF2_MEMOPS=m
CONFIG_VIDEOBUF2_VMALLOC=m
CONFIG_USB_VIDEO_CLASS=m
CONFIG_USB_GSPCA=m
CONFIG_UVC_COMMON=y
CONFIG_I2C=y
CONFIG_I2C_BOARDINFO=y
CONFIG_I2C_CHARDEV=y
CONFIG_I2C_DESIGNWARE_PLATFORM=y
CONFIG_I2C_DESIGNWARE_PCI=y
CONFIG_I2C_PIIX4=y
CONFIG_I2C_ISCH=m
CONFIG_I2C_NFORCE2=m
CONFIG_SPI=y
CONFIG_SPI_PXA2XX=m
CONFIG_PINCTRL=y
CONFIG_PINCTRL_INTEL=y
CONFIG_PINCTRL_TIGERLAKE=y
CONFIG_GPIO_SYSFS=y
CONFIG_GPIO_ACPI=y
CONFIG_GPIO_AMDPT=y
CONFIG_GPIO_IT87=m
CONFIG_RC_CORE=y
CONFIG_RC_LOOPBACK=y
CONFIG_LIRC=y

# --------------------------------------------------------------------------
# firmware, EFI, printk and the /proc+/sys surface
# --------------------------------------------------------------------------
CONFIG_FW_LOADER=y
CONFIG_FW_LOADER_COMPRESS=y
CONFIG_FW_LOADER_COMPRESS_ZSTD=y
CONFIG_FW_UPLOAD=y
CONFIG_EXTRA_FIRMWARE=""
CONFIG_MICROCODE=y
CONFIG_FIRMWARE_TABLE=y
CONFIG_UEFI_CPER=y
CONFIG_EFI=y
CONFIG_EFI_MIXED=y
CONFIG_EFIVAR_FS=m
CONFIG_EFI_STUB=y
CONFIG_EFI_HANDOVER_PROTOCOL=y
CONFIG_EFI_SOFT_RESERVE=y
CONFIG_DMI=y
# CONFIG_EFI_PGT_DUMP is not set
CONFIG_PSTORE=y
CONFIG_PSTORE_RAM=m
CONFIG_PSTORE_COMPRESS=y
CONFIG_PRINTK=y
# CONFIG_PRINTK_INDEX is not set
CONFIG_BUG=y
# CONFIG_BUG_ON_DATA_CORRUPTION is not set
CONFIG_DEBUG_BUGVERBOSE=y
CONFIG_MAGIC_SYSRQ=y
CONFIG_MAGIC_SYSRQ_DEFAULT_ENABLE=0x1
CONFIG_SYSCTL=y
CONFIG_PROC_FS=y
CONFIG_PROC_CHILDREN=y
CONFIG_SYSFS=y
CONFIG_EFI_VARS_PSTORE=m
```
